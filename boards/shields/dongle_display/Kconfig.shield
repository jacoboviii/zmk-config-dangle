## boards/shields/dongle_display/Kconfig.shield
```kconfig
# No whitespace after the comma or in the keyboard name!
config SHIELD_DONGLE_DISPLAY
    def_bool $(shields_list_contains,dongle_display)
```
